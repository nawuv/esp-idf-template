## components/espkit_board/Kconfig.projbuild
```kconfig
menu "ESPKit board and sensor"
config ESPKIT_SENSOR_SHT3X
    bool "Use a physical SHT3x-DIS sensor instead of synthetic input"
    default n
    depends on IDF_TARGET_ESP32S3
    help
        Requires explicitly configured GPIOs and verified board wiring.
        This does not enable any physical actuator.
config ESPKIT_I2C_SDA_GPIO
    int "I2C SDA GPIO (-1 disables hardware access)"
    range -1 48
    default -1
    depends on ESPKIT_SENSOR_SHT3X
config ESPKIT_I2C_SCL_GPIO
    int "I2C SCL GPIO (-1 disables hardware access)"
    range -1 48
    default -1
    depends on ESPKIT_SENSOR_SHT3X
config ESPKIT_SHT3X_ADDRESS
    hex "SHT3x I2C address"
    range 0x44 0x45
    default 0x44
    depends on ESPKIT_SENSOR_SHT3X
endmenu
```

## components/networking/Kconfig.projbuild
```kconfig
menu "ESPKit networking"
config ESPKIT_NETWORK_ENABLED
    bool "Enable Wi-Fi station and MQTT telemetry"
    default n
    select MBEDTLS_CERTIFICATE_BUNDLE
    help
        Credentials are loaded from the espkit NVS namespace at runtime.
        Missing/invalid credentials disable networking; local tasks continue.
config ESPKIT_ALLOW_PLAINTEXT_MQTT
    bool "Allow mqtt:// for an isolated development broker"
    default n
    depends on ESPKIT_NETWORK_ENABLED
    help
        Production defaults require mqtts:// with certificate verification.
        This option sends broker credentials and telemetry without TLS.
endmenu
```

## main/Kconfig.projbuild
```kconfig
menu "ESPKit board and sensor"
config ESPKIT_SENSOR_SHT3X
    bool "Use a physical SHT3x-DIS sensor instead of synthetic input"
    default n
    depends on IDF_TARGET_ESP32S3
    help
        Requires explicitly configured GPIOs and verified board wiring.
        This does not enable any physical actuator.
config ESPKIT_I2C_SDA_GPIO
    int "I2C SDA GPIO (-1 disables hardware access)"
    range -1 48
    default -1
    depends on ESPKIT_SENSOR_SHT3X
config ESPKIT_I2C_SCL_GPIO
    int "I2C SCL GPIO (-1 disables hardware access)"
    range -1 48
    default -1
    depends on ESPKIT_SENSOR_SHT3X
config ESPKIT_SHT3X_ADDRESS
    hex "SHT3x I2C address"
    range 0x44 0x45
    default 0x44
    depends on ESPKIT_SENSOR_SHT3X
endmenu

menu "ESPKit commands"
config ESPKIT_REMOTE_COMMANDS
    bool "Allow remote-sourced commands at the local ingress"
    default n
    help
        Disabled by default. This permits CommandSource::remote to pass
        local admission. It does not subscribe to MQTT, trust the network,
        or drive a physical output. Accepted commands still pass through
        the local TimedOutput policy.
endmenu
```

## sdkconfig.defaults
```kconfig
CONFIG_PARTITION_TABLE_CUSTOM=y
CONFIG_PARTITION_TABLE_CUSTOM_FILENAME="partitions.csv"
CONFIG_BOOTLOADER_APP_ROLLBACK_ENABLE=y
CONFIG_COMPILER_CXX_EXCEPTIONS=n
CONFIG_COMPILER_CXX_RTTI=n
```
